## SafeSeat_Runtime/SafeSeat_Runtime_ESP32S3_CAM/sdkconfig.defaults
```kconfig
CONFIG_IDF_TARGET="esp32s3"

CONFIG_ESPTOOLPY_FLASHMODE_QIO=y
CONFIG_ESPTOOLPY_FLASHSIZE_8MB=y

CONFIG_PARTITION_TABLE_CUSTOM=y
CONFIG_PARTITION_TABLE_CUSTOM_FILENAME="partitions.csv"
CONFIG_PARTITION_TABLE_OFFSET=0x9000

CONFIG_COMPILER_OPTIMIZATION_PERF=y
CONFIG_ESP_DEFAULT_CPU_FREQ_MHZ_240=y

CONFIG_SPIRAM=y
CONFIG_SPIRAM_MODE_OCT=y
CONFIG_SPIRAM_SPEED_80M=y

CONFIG_ESP32S3_INSTRUCTION_CACHE_32KB=y
CONFIG_ESP32S3_DATA_CACHE_64KB=y
CONFIG_ESP32S3_DATA_CACHE_LINE_64B=y
CONFIG_ESP_SYSTEM_ALLOW_RTC_FAST_MEM_AS_HEAP=n

CONFIG_ESP_TASK_WDT_TIMEOUT_S=40

# Store the large YOLO pose model in its own flash partition.
CONFIG_COCO_POSE_MODEL_IN_FLASH_PARTITION=y
# CONFIG_COCO_POSE_MODEL_IN_FLASH_RODATA is not set
# CONFIG_COCO_POSE_MODEL_IN_SDCARD is not set
CONFIG_FLASH_COCO_POSE_YOLO11N_POSE_S8_V2=y
CONFIG_COCO_POSE_YOLO11N_POSE_S8_V2=y
```
